.include "m48def.inc"
;.INCLUDE "BORRAR.ASM"
.DEF	TEMP=R16
.DEF	TEMPH=R17

.DEF	NOWL=R30
.DEF	NOWH=R31
.DEF	DERL=R2
.DEF	DERH=R3
.org 	0x000
	RJMP	RESET
.ORG	0x010
	RJMP TIM0_OVF
.ORG	0x01A
RESET:
	ldi 	r16,high(RAMEND); Main program start
	out 	SPH,r16 ; Set Stack Pointer to top of RAM
	ldi 	r16,low(RAMEND)
	out 	SPL,r16
	SER		TEMP
	OUT		DDRD, TEMP
	OUT		DDRB, TEMP
	LDI		TEMP, 0x01	;VALOR POSICION SERVO 
	MOV		NOWH, TEMP
	LDI		TEMP, 0xF4
	MOV		NOWL, TEMP	;---------
	LDI		TEMP, 0x03
	MOV		DERH, TEMP
	LDI		TEMP, 0xFF
	MOV		DERL, TEMP
;-------------TIMER0-------------------
	LDI		TEMP, 0x17
	OUT		OCR0A, TEMP
	CLR		TEMP
	OUT		TCCR0A, TEMP
	LDI		TEMP,(1<<CS02)|(1<<CS00)
	OUT		TCCR0B, TEMP
	LDI		TEMP, (1<<TOIE0)
	STS		TIMSK0, TEMP
;--------------TIMER1------------------
	LDI		TEMPH, 0x27
	LDI		TEMP, 0x0F
	STS		ICR1H, TEMPH
	STS		ICR1L, TEMP
	STS		OCR1AH, NOWH
	STS		OCR1AL, NOWL
	LDI		TEMP, (1<< COM1A1)|(1<<WGM11)
	STS		TCCR1A, TEMP
	LDI		TEMP, (1<<WGM13)|(1<<WGM12)|(1<<CS11)
	STS		TCCR1B, TEMP
	SEI

LOOP:
	RJMP	LOOP
TIM0_OVF:
	LDI		TEMP, 0xE8
	LDI		TEMPH, 0x03
	CPSE	TEMPH, NOWH
	RJMP	INCREMENTA
	CPSE	TEMP, NOWL
	RJMP	INCREMENTA
	RJMP	REINICIA
INCREMENTA:
	ADIW	NOWL,1
	RJMP	ACTUALIZA
REINICIA:
	LDI		TEMP, 0x01	;VALOR INICIAL 
	MOV		NOWH, TEMP
	LDI		TEMP, 0xF4
	MOV		NOWL, TEMP
ACTUALIZA:
	STS		OCR1AH, NOWH
	STS		OCR1AL, NOWL
;	SEI
	RETI
	.EXIT

